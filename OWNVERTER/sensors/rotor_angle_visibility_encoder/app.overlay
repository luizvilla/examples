/ {
	chosen {
		owntech,position-sensor = &abz;
	};
};

default_motor: default-motor {
		pole-pairs = <4>;
	};

abz: abz {
		counts-per-revolution = <4096>;
		direction-sign = <1>;
		electrical-offset = <0x00000000>;
	};
